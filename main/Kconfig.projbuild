## main/Kconfig.projbuild
```kconfig
menu "Hibernating Tempsensor Config"

    config ESP_WIFI_SSID
        string "WiFi SSID"
        default "myssid"
        help
            SSID (network name) for the example to connect to.

    config ESP_WIFI_PASSWORD
        string "WiFi Password"
        default "mypassword"
        help
            WiFi password (WPA or WPA2) for the example to use.

    config ESP_MAXIMUM_RETRY
        int "Maximum retry"
        default 5
        help
            Set the Maximum retry to avoid station reconnecting to the AP unlimited when the AP is really inexistent.

    config WAKEUP_TIMEOUT
        int "Sleep time"
        default 60
        help
            Set how long the ESP32 will sleep for, before waking up.
    
    config HTTP_URL
        string "HTTP Url"
        default "http://httpbin.org/post"
        help
            The default URL to post data to.
    
    config HOSTNAME
        string "Hostname"
        default "tombaE32x1"
        help
            The hostname of this ESP32.

    config SERVERPW
        string "Server Password"
        default "asdqwe123"
        help
            The password to gain access to posting data to the server.
    
    config ONE_WIRE_GPIO
        int "OneWire GPIO number"
        range 0 34
        default 5
        help
            GPIO number (IOxx) to access One Wire Bus.

            Some GPIOs are used for other purposes (flash connections, etc.) and cannot be used.

            GPIOs 35-39 are input-only so cannot be used to drive the One Wire Bus.
    
    config POWER_1W_GPIO
        int "1W Power GPIO number"
        range 0 34
        default 9
        help
            GPIO number (IOxx) to power the One Wire Bus.

            Some GPIOs are used for other purposes (flash connections, etc.) and cannot be used.

            GPIOs 35-39 are input-only so cannot be used to drive the One Wire Bus.

endmenu
```
